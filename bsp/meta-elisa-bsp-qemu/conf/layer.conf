## bsp/meta-elisa-bsp-qemu/conf/layer.conf
```bitbake
# We have a conf and classes directory, add to BBPATH
BBPATH .= ":${LAYERDIR}"

# We have recipes-* directories, add to BBFILES
BBFILES += "${LAYERDIR}/recipes-*/*/*.bb \
            ${LAYERDIR}/recipes-*/*/*.bbappend"

BBFILE_COLLECTIONS += "meta-elisa-bsp-qemu"
BBFILE_PATTERN_meta-elisa-bsp-qemu = "^${LAYERDIR}/"
BBFILE_PRIORITY_meta-elisa-bsp-qemu = "10"

LAYERDEPENDS_meta-elisa-bsp-qemu = "core"
LAYERSERIES_COMPAT_meta-elisa-bsp-qemu = "dunfell"
```

## meta-elisa-demo/conf/layer.conf
```bitbake
# We have a conf and classes directory, add to BBPATH
BBPATH .= ":${LAYERDIR}"

# We have recipes-* directories, add to BBFILES
BBFILES += "${LAYERDIR}/recipes-*/*/*.bb \
            ${LAYERDIR}/recipes-*/*/*.bbappend"

BBFILE_COLLECTIONS += "meta-elisa-demo"
BBFILE_PATTERN_meta-elisa-demo = "^${LAYERDIR}/"
BBFILE_PRIORITY_meta-elisa-demo = "30"

LAYERDEPENDS_meta-elisa-demo = "meta-elisa"
LAYERSERIES_COMPAT_meta-elisa-demo = "kirkstone"
```

## meta-elisa/conf/layer.conf
```bitbake
# We have a conf and classes directory, add to BBPATH
BBPATH .= ":${LAYERDIR}"

# We have recipes-* directories, add to BBFILES
BBFILES += "${LAYERDIR}/recipes-*/*/*.bb \
            ${LAYERDIR}/recipes-*/*/*.bbappend"

BBFILE_COLLECTIONS += "meta-elisa"
BBFILE_PATTERN_meta-elisa = "^${LAYERDIR}/"
BBFILE_PRIORITY_meta-elisa = "30"

LAYERDEPENDS_meta-elisa = "core"
LAYERSERIES_COMPAT_meta-elisa = "dunfell"

IMAGE_INSTALL_append = " hello-world"
PREFERRED_VERSION_linux-yocto = "5.9%"
```
